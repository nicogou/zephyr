## boards/shields/seeed_xiao_round_display/Kconfig.defconfig
```kconfig
# Copyright (c) 2024 Nicolas Goualard <nicolas.goualard@sfr.fr>
# SPDX-License-Identifier: Apache-2.0

if SHIELD_SEEED_XIAO_ROUND_DISPLAY

if DISPLAY

if SHIELD_SEEED_XIAO_ROUND_DISPLAY_BACKLIGHT

config GC9X01X_BACKLIGHT
	default y

endif # SHIELD_SEEED_XIAO_ROUND_DISPLAY_BACKLIGHT

if LVGL

config INPUT
	default y

choice LV_COLOR_DEPTH
	default LV_COLOR_DEPTH_16
endchoice

config LV_COLOR_16_SWAP
	default y

endif # LVGL
endif # DISPLAY

if INPUT
config INPUT_CHSC6X
	default y

endif # INPUT

endif # SHIELD_XIAO_ROUND_DISPLAY
```

## drivers/display/Kconfig.gc9x01x
```kconfig
# Copyright 2023 Martin Kiepfer <mrmarteng@teleschirm.org>
# SPDX-License-Identifier: Apache-2.0

config GC9X01X
	bool "GC9X01X display driver"
	default y
	depends on DT_HAS_GALAXYCORE_GC9X01X_ENABLED
	select SPI
	help
	  Enable driver for GC9X01X display driver.

config GC9X01X_BACKLIGHT
	bool "GC9X01X backlight PWM control"
	default n
	depends on GC9X01X
	select PWM
	help
		Enable GC9X01X backlight control
```
